/*****************************************************************************
* File    : GC_timer.ino
* Author  : 惜枫醉
* Date    : 2017/04/06
* Brief   : 定时器文件,提供一个定时启动函数和一个注册函数，用户可以往里注册需要定时中断的函数
            任务个数由TIMER_MAX_JOB 决定，目前不提供注销注册的方法
*
* Copyright (c) 2000-2020 惜枫醉 All Rights Reserved.
* Remarks :修改日志
******************************************************************************/


/*****************************************************************************
*                               头文件引用
******************************************************************************/


/*****************************************************************************
*                                常量定义
******************************************************************************/
TIMER_JobContext jobs[TIMER_MAX_JOB];


/*****************************************************************************
*                                 宏定义
******************************************************************************/
#define TICK_GAP 1

/*****************************************************************************
*                              数据类型定义
******************************************************************************/


/*****************************************************************************
*                                函数声明
******************************************************************************/


/*****************************************************************************
*                                变量定义
******************************************************************************/
/*****************************************************************************
* Author  : 惜枫醉
* Date    : 2017/04/06
* Brief   : 定时器服务，每隔5ms进一次中断，进行定时任务查询处理
* Return  : 
* Remarks : 
******************************************************************************/
static void TIMER_ISR(void)
{
    static unsigned int tick = 0;
    unsigned char ii=0;
    tick++;
    for(ii=0;ii<TIMER_MAX_JOB;ii++)
    {
        if(jobs[ii].isRegitered)
        {
            if(!(tick % jobs[ii].jobGapMs*TICK_GAP))
            {
                jobs[ii].event();
            }
        }
    }
}

/*****************************************************************************
* Author  : 惜枫醉
* Date    : 2017/04/06
* Brief   : 定时任务初始化，一旦初始化后，任务就会一直走下去，停止的办法有关中断，停止定时器
* Return  : 
* Remarks : 
******************************************************************************/
void TIMER_init(void)

{
    MsTimer2::set(TICK_GAP, TIMER_ISR);
    MsTimer2::start();
    
}

/*****************************************************************************
* Author  : 惜枫醉
* Date    : 2017/04/06
* Brief   : 注册一个定时任务到定时任务工作队列去
* param job
* param timeGapMs
* Return  : 
* Remarks : 
******************************************************************************/
void TIMER_register(unsigned int timeGapMs,void (*job)(void))
{
    char ii=0;

    for(ii=0;ii<TIMER_MAX_JOB;ii++)
    {
        if(jobs[ii].isRegitered == 0)
        {
            jobs[ii].jobGapMs = timeGapMs;
            jobs[ii].isRegitered = 1;
            jobs[ii].event = job;
            break;
        }
    }
    

}


